## defconfig
```kconfig
#
# core
#

BR2_x86_64=y
BR2_WGET="wget --passive-ftp -nd -t 3 -nv"

# toolchain
BR2_TOOLCHAIN_EXTERNAL=y
BR2_TOOLCHAIN_EXTERNAL_PATH="$(HOME)/toolchain"
BR2_TOOLCHAIN_EXTERNAL_CUSTOM=y
BR2_TOOLCHAIN_EXTERNAL_CUSTOM_GLIBC=y
BR2_TOOLCHAIN_EXTERNAL_CUSTOM_PREFIX="x86_64-justcontainers-linux-gnu"
BR2_TOOLCHAIN_EXTERNAL_GCC_4_9=y
BR2_TOOLCHAIN_EXTERNAL_HEADERS_4_0=y
BR2_TOOLCHAIN_EXTERNAL_LARGEFILE=y
BR2_TOOLCHAIN_EXTERNAL_INET_IPV6=y
BR2_TOOLCHAIN_EXTERNAL_WCHAR=y
BR2_TOOLCHAIN_EXTERNAL_CXX=y

# 
# additional utilities
#  - iptables: just in case
#  - openssl: because it's useful to access TLS backed endpoint inside container (ex. using wget)
#  - disable init
#
BR2_PACKAGE_IPTABLES=y
BR2_PACKAGE_OPENSSL=y
BR2_INIT_NONE=y

# output formats
BR2_TARGET_ROOTFS_TAR_XZ=y
BR2_TARGET_ROOTFS_TAR_GZIP=y
BR2_TARGET_ROOTFS_TAR_BZIP2=y

# hostname
BR2_TARGET_GENERIC_HOSTNAME="mono"
BR2_TARGET_GENERIC_ISSUE="mono"

#
# mono + ca-certificates
#
BR2_PACKAGE_MONO_ARCH_SUPPORTS=y
BR2_PACKAGE_MONO=y
BR2_PACKAGE_CA_CERTIFICATES=y
# additional rootfs customizations
BR2_ROOTFS_USERS_TABLES="$(HOME)/usertable.txt"
BR2_ROOTFS_POST_BUILD_SCRIPT="$(HOME)/postbuild.sh"
# until this is fixed in the stable branch: 
# https://github.com/mono/mono/commit/73e4bfeac790cee7681f3797caee41b65186fe7e
BR2_TARGET_TZ_INFO=y
BR2_TARGET_LOCALTIME="Etc/UTC"
```
